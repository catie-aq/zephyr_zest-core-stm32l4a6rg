## boards/catie/zest_core_stm32l4a6rg/board.yml
```yaml
board:
  name: zest_core_stm32l4a6rg
  full_name: Zest_Core_STM32L4A6RG
  vendor: catie
  socs:
    - name: stm32l4a6xx
  revision:
    format: "major.minor.patch"
    default: "3.1.1"
    exact: true
    revisions:
      - name: "3.0.0"
      - name: "3.1.0"
      - name: "3.1.1"
```
